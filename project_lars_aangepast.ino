#include <Adafruit_NeoPixel.h>
#include <SoftwareSerial.h>

// We will use the SoftwareSerial library instead of the Serial library, as this will let us control which pins our MIDI interface is connected to.
SoftwareSerial mySerial(5, 6); // RX, TX , maakt een serieele poort aan op pin 5 en 6

// constants
const int midiSendDelay = 100; // give MIDI-device a short time to "digest" MIDI messages
byte midiByte;                 // De MidiByte dat van de piano komt wordt onder midiByte bewaard
bool ThereIsSignal;            // Wordt hoog als er een er een signaal is
bool ThereIsToets;             // Wordt hoog als er een toets is
bool serprint;                 // Als al de gegevens van een toets zijn aangekomen wordt deze hoog
bool ingedrukt;                // Is hoog als de toets ingedrukt is en laag als deze niet ingedrukt is
byte toets[2];                 // De Array met de gegevens van de toets eerste is hoe hard te toets gelagen is en de 2de is de waarde om welke toets het gaat
int fadedel=2600;              // De tijd dat een toets mag faden
int tijddel = 0;               // De tijd die wordt gebruikt om te faden

#define PIN 9                  //pin van data strip
#define AANTAL 100             //aantal leds op strip
#define KNOPPIN 2              //pin nummer van knop
  
// Parameter 1 = number of pixels in strip
// Parameter 2 = pin number (most are valid)
// Parameter 3 = pixel type flags, add together as needed:
//   NEO_KHZ800  800 KHz bitstream (most NeoPixel products w/WS2812 LEDs)
//   NEO_KHZ400  400 KHz (classic 'v1' (not v2) FLORA pixels, WS2811 drivers)
//   NEO_GRB     Pixels are wired for GRB bitstream (most NeoPixel products)
//   NEO_RGB     Pixels are wired for RGB bitstream (v1 FLORA pixels, not v2)
Adafruit_NeoPixel strip = Adafruit_NeoPixel(AANTAL, PIN, NEO_RGB + NEO_KHZ800);

//in deze array zitten de bitpatronen van alle letters (7x11) 0=A - 1=B - 2=C
char letter[61][11]={
  {0xff,0xc3,0xc3,0xc3,0xc3,0xff,0xc3,0xc3,0xc3,0xc3,0xc3}, //A
  {0xfd,0xc5,0xc5,0xc5,0xc5,0xfd,0xc3,0xc3,0xc3,0xc3,0xff}, //B
  {0xff,0xc1,0xc1,0xc1,0xc1,0xc1,0xc1,0xc1,0xc1,0xc1,0xff}, //C
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{0x29, 0x29, 0x29, 0x29, 0xff, 0x29, 0xff, 0x29, 0x29, 0x29, 0x29} // #

};

// Dit loopt maar 1 keer als de arduino opstart
void setup() { 
  strip.begin();                        // het beginnen van de led's
  strip.show();                         // Zet al de Leds op uit

   // setup SoftSerial for MIDI control
    mySerial.begin(31250);              // Zorgt dat de serieele communicatie van de middi input op een snelheid van 31250 komt te staan
    Serial.begin(38400);                // Zet de Serieele communicatie voor het monitoren van het programma op 38400
    delay(midiSendDelay);               // Wacht even voor een midi signaal 
}

// Dit zal blijven lopen in een loop
void loop() {


    if (mySerial.available() > 0) {     // kijkt of er een midi signaal aanwezig is 
        // read MIDI byte

        midiByte = mySerial.read();    // Slaagt de serieele byte op in midiByte
        
        checksignaal(midiByte);        // Gaat naar de functie checksignaal en geeft de waarde midiByte mee
        Serial.println(midiByte);      // Print de midi waarde af voor monitoring

        if(serprint){                  // Als al de gegevens van de toets aangekomen zijn ga hierin
          
            Serial.println(toets[0]);  // Print de hoe hard te toets gelagen waarde af voor monitoring
            Serial.println(toets[1]);  // Print de toets af voor monitoring

            toets[1] = toets[1]-35;    // De waarde om welke toets het gaat -35 doen  
            printletter(toets[1],toets[0]); // Zet de leds goed die de letter vormen en geeft ineens de helderheid mee
            
            strip.show();              // Laat de Led's aangaan
            serprint = LOW;            // zet de waardes terug op laag
            ThereIsSignal = LOW;
            ThereIsToets = LOW;         
          } 
             
    } 
  fadeout();

}

void fadeout(){
  if(toets[0]>0){

    if (tijddel > fadedel){
        
          if(toets[0]>35){
           toets[0] -=2;
           
          }
          toets[0] --;
          printletter(toets[1],toets[0]);
          strip.show();
        
      tijddel=0;
    }
    else if (!ingedrukt){
      tijddel += 3;
    }else{
      tijddel ++;
    }
  }
}
void checksignaal(byte midiByte){
    if(midiByte == 147){
      ThereIsSignal = HIGH;
      return;
    }/*else if(midiByte<248 && !ThereIsToets && !ThereIsSignal ){
      if(midiByte == toets[1]){
        ingedrukt = LOW;
      }
    }*/
    if(ThereIsToets){
      serprint = HIGH;
     
      if(midiByte>0){
         toets[0] = midiByte;
        ingedrukt =HIGH;
      }else{
        ingedrukt = LOW;
      }
       
      return;

    }
    
    if(ThereIsSignal){
      toets[1] = midiByte;
      ThereIsToets = HIGH;
      return;
      /*if (toets[1] == midiByte){
        ingedrukt = LOW;
        return;
      }else{
        toets[1] = midiByte;
        ingedrukt = HIGH;
        return;
      } */
    }

}

/*******************************************/
void printletter(char alpha, char br)
{
  char i,j,k,l;
  char lednr=0;
  alpha--;
  for(i=0;i<11;i++) //i staat voor de 11 arrays om de letter te vormen
  {
    if(i%2) //bij oneven rijen (1 3 5 7 9)
    {                    //j staat voor de 7 bits per register die nodig zijn
      for(j=1;j<8;j++)   //van LSB naar MSB en skip bit0
      {                
        if(letter[alpha][i] & (0x01<<j))
        {
          strip.setPixelColor(lednr,strip.Color(br,br,br));
          lednr++;
          //Serial.print("1");
        }
        else
        {
          strip.setPixelColor(lednr,strip.Color(0,0,0));
          lednr++;
          //Serial.print("0");
        }
      }
    }
/***/
    else //bij even rijen (0 2 4 6 8 10)
    {                    //j staat voor de 7 bits per register die nodig zijn
      for(j=0;j<7;j++)   //van MSB naar LSB en skip bit0
      {                
        if(letter[alpha][i] & (0x80>>j))
        {
          strip.setPixelColor(lednr,strip.Color(br,br,br));
          lednr++;
          //Serial.print("1");
        }
        else
        {
          strip.setPixelColor(lednr,strip.Color(0,0,0));
          lednr++;
          //Serial.print("0");
        }
      }
    }
  }
}

